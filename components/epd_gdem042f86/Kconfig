## components/epd_gdem042f86/Kconfig
```kconfig
menu "EPaperFrame"

config EPD_PIN_SCK
    int "EPD SPI SCLK GPIO"
    default 12

config EPD_PIN_MOSI
    int "EPD SPI MOSI GPIO"
    default 11

config EPD_PIN_CS
    int "EPD chip select GPIO"
    default 10

config EPD_PIN_DC
    int "EPD data/command GPIO"
    default 13

config EPD_PIN_RST
    int "EPD reset GPIO"
    default 14

config EPD_PIN_BUSY
    int "EPD busy GPIO"
    default 21

config EPD_SPI_CLOCK_HZ
    int "EPD SPI clock (Hz)"
    range 100000 10000000
    default 1000000

config EPD_FB_IN_PSRAM
    bool "Allocate frame buffer in PSRAM"
    default n

endmenu
```

## sdkconfig.defaults
```kconfig
CONFIG_IDF_TARGET="esp32s3"
CONFIG_ESPTOOLPY_FLASHSIZE_16MB=y
CONFIG_PARTITION_TABLE_CUSTOM=y
CONFIG_PARTITION_TABLE_CUSTOM_FILENAME="partitions.csv"
CONFIG_SPIRAM=y
CONFIG_SPIRAM_MODE_OCT=y
CONFIG_SPIRAM_SPEED_80M=y
CONFIG_ESP_CONSOLE_UART_DEFAULT=y
CONFIG_ESP_CONSOLE_UART_BAUDRATE=115200
CONFIG_FREERTOS_HZ=1000
CONFIG_LOG_DEFAULT_LEVEL_INFO=y

CONFIG_EPD_SPI_CLOCK_HZ=1000000
```
